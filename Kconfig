## Kconfig
```kconfig
mainmenu "Lumin OS Configuration"

menu "General setup"

config SMP
	bool "Symmetric multi-processing"
	default n
	help
	  Enable SMP support for multi-core CPUs.

config EXPERIMENTAL
	bool "Enable experimental features"
	default n

endmenu

source "kernel/Kconfig"
source "kernel/drivers/Kconfig"
source "user/Kconfig"
```

## kernel/Kconfig
```kconfig
menu "Kernel"

source "kernel/mm/Kconfig"
source "kernel/proc/Kconfig"
source "kernel/fs/Kconfig"
source "kernel/block/Kconfig"

endmenu
```

## kernel/block/Kconfig
```kconfig
menu "Block layer"

config BLOCK
	bool "Block device layer"
	default y
	help
	  Generic block device interface with partition support.

endmenu
```

## kernel/drivers/Kconfig
```kconfig
menu "Device drivers"

config FB
	bool "Framebuffer (VBE)"
	default y
	help
	  VESA VBE linear framebuffer driver (1024x768x32).

config VGA
	bool "VGA text mode"
	default y
	help
	  Standard VGA text-mode console (80x25, 0xB8000).

config SERIAL
	bool "Serial port"
	default y
	help
	  COM1 serial port driver for debugging output.

config KEYBOARD
	bool "PS/2 keyboard"
	default y
	help
	  PS/2 keyboard driver with scancode translation.

config PCI
	bool "PCI bus"
	default y
	help
	  PCI configuration space scanner.

config ATA
	bool "ATA/PATA"
	default y
	depends on PCI
	help
	  Parallel ATA disk driver.

config ACPI
	bool "ACPI"
	default y
	help
	  ACPI table parsing (RSDP, RSDT, MADT, etc.).

config RTC
	bool "Real-time clock"
	default y
	help
	  CMOS RTC driver for date/time.

choice
	prompt "Timer driver"
	default TIMER_HPET

config TIMER_HPET
	bool "HPET"
	depends on ACPI
	help
	  High Precision Event Timer.

config TIMER_PIT
	bool "PIT (8254)"
	help
	  Legacy Programmable Interval Timer.

config TIMER_LAPIC
	bool "LAPIC timer"
	depends on SMP
	help
	  Local APIC timer.

endchoice

endmenu
```

## kernel/fs/Kconfig
```kconfig
menu "File systems"

config VFS
	bool "Virtual file system"
	default y
	help
	  Abstract VFS layer with mount points and file operations.

config FAT32
	bool "FAT32 file system"
	default y
	depends on VFS && BLOCK
	help
	  FAT32 file system driver for block devices.

endmenu
```

## kernel/mm/Kconfig
```kconfig
menu "Memory management"

config PMM
	bool "Physical memory manager"
	default y
	help
	  Page-based physical memory manager using E820 memory map.

config VMM
	bool "Virtual memory manager"
	default y
	depends on PMM
	help
	  x86-64 page table management. Requires PMM.

config KMALLOC
	bool "Kernel heap allocator"
	default y
	depends on PMM
	help
	  General-purpose kernel heap allocator built on PMM.

endmenu
```

## kernel/proc/Kconfig
```kconfig
menu "Process management"

config TASKS
	bool "Multitasking"
	default y
	help
	  Preemptive scheduler, context switching, process lifecycle.

config ELF
	bool "ELF loader"
	default y
	depends on TASKS
	help
	  Load ELF-64 executables into userspace.

config SYSCALL
	bool "Syscall interface"
	default y
	depends on TASKS
	help
	  Syscall handler for userspace programs (int $0x30).

endmenu
```

## user/Kconfig
```kconfig
menu "Userspace programs"

comment "Programs are built as ELF-64 and placed on the FAT32 image."

config SHELL
	bool "Shell"
	default y
	help
	  Interactive shell with command history and line editing.

config HELLO
	bool "Hello test"
	default y
	help
	  Simple ELF test program.

config COREUTILS
	bool "Core utilities"
	default y
	help
	  Build ls, cat, echo, clear, help, ed, cp, mv, rm utilities.

config SBIN
	bool "System binaries"
	default y
	help
	  Build init.elf and other system programs that live in /system/sbin/.

endmenu
```
